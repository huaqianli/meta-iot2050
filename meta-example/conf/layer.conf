## meta-example/conf/layer.conf
```bitbake
#
# IoT2050 Example/Demo Layer Configuration
#
# Copyright (c) Siemens AG, 2025
#
# Authors:
#  Li Hua Qian <huaqian.li@siemens.com>
#
# SPDX-License-Identifier: MIT
#

BBPATH .= ":${LAYERDIR}"

BBFILES += "${LAYERDIR}/recipes-*/*/*.bb \
        ${LAYERDIR}/recipes-*/*/*.bbappend"

BBFILE_COLLECTIONS += "meta-iot2050-example"
BBFILE_PATTERN_meta-iot2050-example = "^${LAYERDIR}/"
BBFILE_PRIORITY_meta-iot2050-example = "8"

LAYERSERIES_COMPAT_meta-iot2050-example = "next"

LAYERDIR_meta-iot2050-example = "${LAYERDIR}"
LAYERDIR_meta-iot2050-example[vardepvalue] = "meta-iot2050-example"

# Layer dependencies
LAYERDEPENDS_meta-iot2050-example = "meta-iot2050-bsp"

# Demo and example applications layer
```

## meta-node-red/conf/layer.conf
```bitbake
#
# IoT2050 Node-RED Layer Configuration
#
# Copyright (c) Siemens AG, 2025
#
# Authors:
#  Li Hua Qian <huaqian.li@siemens.com>
#
# SPDX-License-Identifier: MIT
#

BBPATH .= ":${LAYERDIR}"

BBFILES += "${LAYERDIR}/recipes-*/*/*.bb \
        ${LAYERDIR}/recipes-*/*/*.bbappend"

BBFILE_COLLECTIONS += "meta-iot2050-node-red"
BBFILE_PATTERN_meta-iot2050-node-red = "^${LAYERDIR}/"
BBFILE_PRIORITY_meta-iot2050-node-red = "8"

LAYERSERIES_COMPAT_meta-iot2050-node-red = "next"

LAYERDIR_meta-iot2050-node-red = "${LAYERDIR}"
LAYERDIR_meta-iot2050-node-red[vardepvalue] = "meta-iot2050-node-red"

# Layer dependencies
LAYERDEPENDS_meta-iot2050-node-red = "meta-iot2050-bsp"

# Node-RED ecosystem support layer
```

## meta-sm/conf/layer.conf
```bitbake
#
# IoT2050-SM Board Variant Layer Configuration
#
# Copyright (c) Siemens AG, 2025
#
# Authors:
#  Li Hua Qian <huaqian.li@siemens.com>
#
# SPDX-License-Identifier: MIT
#

BBPATH .= ":${LAYERDIR}"

BBFILES += "${LAYERDIR}/recipes-*/*/*.bb \
        ${LAYERDIR}/recipes-*/*/*.bbappend"

BBFILE_COLLECTIONS += "meta-sm"
BBFILE_PATTERN_meta-sm = "^${LAYERDIR}/"
BBFILE_PRIORITY_meta-sm = "9"

LAYERSERIES_COMPAT_meta-sm = "next"

LAYERDIR_meta-sm = "${LAYERDIR}"
LAYERDIR_meta-sm[vardepvalue] = "meta-sm"

# Layer dependencies
LAYERDEPENDS_meta-sm = "meta-iot2050-bsp"

# IoT2050-SM board variant specific layer
```

## meta-sm/conf/machine/iot2050-sm.conf
```bitbake
#
# IoT2050-SM Machine Configuration
#
# Copyright (c) Siemens AG, 2025
#
# Authors:
#  Li Hua Qian <huaqian.li@siemens.com>
#
# SPDX-License-Identifier: MIT
#

#@TYPE: Machine
#@NAME: iot2050-sm
#@DESCRIPTION: Machine configuration for Siemens IoT2050-SM variant

require conf/machine/iot2050.conf

MACHINE_FEATURES += "sm-variant"

# SM-specific device tree
KERNEL_DEVICETREE = " \
    ti/k3-am65-iot2050-sm.dtb \
"

# SM-specific U-Boot configuration
UBOOT_MACHINE = "iot2050_sm_defconfig"
```

## meta/wic/iot2050-image.wks
```
# IoT2050 WIC (OpenEmbedded Image Creator) file
#
# This file defines the disk layout for IoT2050 images
#
# Copyright (c) Siemens AG, 2025
#
# Authors:
#  Li Hua Qian <huaqian.li@siemens.com>
#
# SPDX-License-Identifier: MIT

# EFI System Partition
part /boot/efi --source bootimg-efi --sourceparams="loader=u-boot" --ondisk sda --label efi --part-type=EF00 --align 1024 --size 64

# Boot partition for kernel and device trees
part /boot --source isar-rootfs --rootfs-dir=${WORKDIR}/boot-rootfs --ondisk sda --fstype=ext4 --label boot --align 1024 --size 256

# Root filesystem partition
part / --source isar-rootfs --ondisk sda --fstype=ext4 --label root --align 1024 --size 2048 --extra-space 512

# Data partition for user data
part /var/lib/iot2050 --ondisk sda --fstype=ext4 --label data --align 1024 --size 1024

bootloader --ptable gpt --timeout=3 --append="console=ttyS2,115200 earlycon=ns16550a,mmio32,0x02800000"
```
